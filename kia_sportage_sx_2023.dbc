VERSION ""

NS_ :

BS_:

BU_: XXX

BO_ 256 ACCELERATOR: 32 XXX
 SG_ CHECKSUM : 7|16@0+ (1,0) [0|65535] "" XXX
 SG_ COUNTER : 23|8@0+ (1,0) [0|255] "" XXX
 SG_ BRAKE_PRESSED : 32|1@0+ (1,0) [0|1] "" XXX
 SG_ ACCELERATOR_PEDAL : 95|8@0+ (1,0) [0|255] "" XXX

BO_ 784 GEAR: 32 XXX
 SG_ GEAR : 159|8@0+ (1,0) [0|7] "" XXX
 SG_ CHECKSUM : 7|16@0+ (1,0) [0|65535] "" XXX
 SG_ COUNTER : 23|8@0+ (1,0) [0|255] "" XXX
